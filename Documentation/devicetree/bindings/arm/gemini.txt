## Documentation/devicetree/bindings/arm/gemini.txt
```
Cortina systems Gemini platforms

The gemini SoC is an ARMv4 SoC from Cortina systems used for NAS
and similar usecases.

Required properties (in root node):
	compatible = "cortina,gemini";

Required nodes:

- syscon: the root node must have a system controller node pointing to the
  global control registers, with the compatible string
  "cortina,gemini-syscon", "syscon";

- timer: the root node must have a timer node pointing to the SoC timer
  block, with the compatible string "cortina,gemini-timer"
  See: clocksource/cortina,gemini-timer.txt

- intcon: the root node must have an interrupt controller node pointing to
  the SoC interrupt controller block, with the compatible string
  "cortina,gemini-interrupt-controller"
  See interrupt-controller/cortina,gemini-interrupt-controller.txt

Example:

/ {
	interrupt-parent = <&intcon>;

	syscon: syscon@40000000 {
		compatible = "cortina,gemini-syscon", "syscon";
		reg = <0x40000000 0x1000>;
	};

	timer@43000000 {
		compatible = "cortina,gemini-timer";
		reg = <0x43000000 0x1000>;
		interrupt-parent = <&intcon>;
		interrupts = <14 IRQ_TYPE_EDGE_RISING>, /* Timer 1 */
			   <15 IRQ_TYPE_EDGE_RISING>, /* Timer 2 */
			   <16 IRQ_TYPE_EDGE_RISING>; /* Timer 3 */
		syscon = <&syscon>;
	};

	uart0: serial@42000000 {
		compatible = "ns16550a";
		reg = <0x42000000 0x100>;
		clock-frequency = <48000000>;
		interrupts = <18 IRQ_TYPE_LEVEL_HIGH>;
		reg-shift = <2>;
	};

	intcon: interrupt-controller@48000000 {
		compatible = "cortina,gemini-interrupt-controller";
		reg = <0x48000000 0x1000>;
		interrupt-controller;
		#interrupt-cells = <2>;
	};
};
```

## Documentation/devicetree/bindings/usb/faraday,fotg210.txt
```
Faraday FOTG Dual role controller

This OTG-capable host/device mode USB controller is found in Cortina Systems
Gemini and other SoC products.
On Gemini currently host mode is used

Required properties:
- compatible: should be one of:
  "faraday,fotg210-dr"
  "cortina,gemini-usb", "faraday,fotg210-dr"
- reg: should contain one register range i.e. start and length
- interrupts: description of the interrupt line

Optional properties:
- clocks: should contain the IP block clock
- clock-names: should be "PCLK" for the IP block clock
- dr_mode : indicates the working mode for "faraday,fotg210-dr" compatible
   controllers.  Can be "host" or "peripheral"
   Default to "host" if not defined for backward compatibility.


Required properties for "cortina,gemini-usb" compatible:
- syscon: a phandle to the system controller to access PHY registers

Optional properties for "cortina,gemini-usb" compatible:
- cortina,gemini-mini-b: boolean property that indicates that a Mini-B
  OTH connector is in use
- wakeup-source: see power/wakeup-source.txt

Example for Gemini:

usb@68000000 {
	compatible = "cortina,gemini-usb", "faraday,fotg210-dr";
	reg = <0x68000000 0x1000>;
	interrupts = <10 IRQ_TYPE_LEVEL_HIGH>;
	clocks = <&cc 12>;
	clock-names = "PCLK";
	syscon = <&syscon>;
	wakeup-source;
};
```

## Documentation/devicetree/bindings/watchdog/cortina,gemin-watchdog.txt
```
Cortina Systems Gemini SoC Watchdog

Required properties :
- compatible : must be "cortina,gemini-watchdog"
- reg : shall contain base register location and length
- interrupts : shall contain the interrupt for the watchdog

- timeout-sec : shall contain the default watchdog timeout in seconds,
                if unset, the default timeout is 13 seconds

Example:

watchdog@41000000 {
	compatible = "cortina,gemini-watchdog";
	reg = <0x41000000 0x1000>;
	interrupts = <3 IRQ_TYPE_LEVEL_HIGH>;
};
```
